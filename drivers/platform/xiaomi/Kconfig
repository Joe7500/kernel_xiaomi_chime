## drivers/platform/xiaomi/Kconfig
```kconfig
menu "Xiaomi board selection"

config MACH_XIAOMI
	bool "Xiaomi device"
	depends on ARCH_QCOM
	help
	  Support for Xiaomi products

config MACH_CHIME
	bool "Chime board"
	select MACH_XIAOMI
	help
	  Support for Chime boards

config MACH_XIAOMI_LIME
	bool "Xiaomi lime board"
	select MACH_CHIME
	help
	  Support for Xiaomi Redmi 9T and equivalents

config MACH_XIAOMI_CITRUS
	bool "Xiaomi Citrus board"
	select MACH_CHIME
	help
	  Support for Xiaomi POCO M3

endmenu
```
